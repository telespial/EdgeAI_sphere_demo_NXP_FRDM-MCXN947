## sdk_example/mcuxsdk_examples_overlay/demo_apps/edgeai_sand_demo/Kconfig
```kconfig
# It is optional to provide example specific Kconfig.

rsource "${SdkRootDirPath}/Kconfig.mcuxpresso"

mainmenu "EdgeAI Sand Demo Configuration"

menuconfig EDGEAI_USE_PAR_LCD_S035
    bool "Enable PAR-LCD-S035 (FlexIO ST7796S) display"
    default y
    help
      Enables the MCUX display bus + controller drivers required for the
      FRDM-MCXN947 PAR-LCD-S035 shield (ST7796S, 8080 via FlexIO).

if EDGEAI_USE_PAR_LCD_S035

config EDGEAI_USE_PAR_LCD_S035_DRIVERS
    bool
    default y
    # The dbi_* drivers are intentionally hidden in MCUX; select them via an app prompt.
    select MCUX_COMPONENT_driver.dbi_flexio_edma
    select MCUX_COMPONENT_driver.st7796s

endif

menuconfig EDGEAI_USE_POSTFX
    bool "Enable post-process effects (CPU)"
    default y
    help
      Adds a cheap post-process pass for scanlines/vignette.

menuconfig EDGEAI_USE_NPU_POSTFX
    bool "Use NPU for postfx (stub)"
    default n
    help
      Scaffolding toggle for routing the post-process stage through an NPU-backed
      implementation. Currently a stub (falls back to CPU).
```
